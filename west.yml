## west.yml
```yaml
# West manifest for nVidia Jetson BSP

manifest:
  defaults:
    remote: ns-custom
    revision: jetson_36.2

  remotes:
    - name: ns-custom
      url-base: https://github.com/sradcliffe-nottinghamspirk
  
# Uncomment the following line for to skip source
#  group-filter: [-source]

  projects:
    - name: otodx-linux-src
      path: source
      import:
        path-prefix: l4t/

  self:
    path: l4t
```
